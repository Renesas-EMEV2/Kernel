## arch/arm/mach-emxx/Kconfig
```kconfig
if ARCH_EMXX

menu "EMMA Mobile series Implementations"

choice
	prompt "EMMA Mobile Core Type"
	default MACH_EMEV

config MACH_EMEV
	bool "EMMA Mobile EV1/EV2"
	select CPU_V7

config MACH_EMGR
	bool "EMMA Mobile EV0"
	select CPU_V7
endchoice

choice
	prompt "EMMA Mobile Board Type"
	default EMEV_BOARD_EVA

config EMEV_BOARD_EVA
	bool "EMMA Mobile EV1/2 Evaluation board"
	depends on MACH_EMEV

config EMGR_BOARD_EVA
	bool "EMMA Mobile EV0 Evaluation board"
	depends on MACH_EMGR
endchoice

if MACH_EMGR
choice
	prompt "EMMA Mobile EV0 Memory size"
	default EMGR_2G_MEM

config EMGR_2G_MEM
	bool "2G Bit"

config EMGR_1G_MEM
	bool "1G Bit"
endchoice
endif

config EMGR_TI_PMIC
	bool "TI power board support"
	depends on EMGR_BOARD_EVA

config EMXX_QR
	bool "Enable QR"
	default y

config EMXX_L310
	bool "ARM L2 cache Enable"
	default y
	select CACHE_L2X0
	select EMXX_L310_NORAM if MACH_EMGR

config EMXX_L310_NORAM
	bool
	depends on MACH_EMGR

if MACH_EMEV

choice
	prompt "L2 cache way-size"
	depends on EMXX_L310
	default EMXX_L310_8WAY

config EMXX_L310_8WAY
	bool "8way 32KByte"

config EMXX_L310_16WAY
	bool "16way 16KByte"
endchoice

endif

config EMXX_ANDROID
	bool "Use Android setting"

config EMXX_SPI0
	bool "SPI0 Driver support"
	default y

config EMXX_SPI_EXCL_SP0
	int "SP0 Exclusive control method (0:scheduling/1:interrupt disabled)"
	depends on EMXX_SPI0
	default "1"

config EMXX_SPI
	tristate "SPI Driver support (SPI1)"

config EMXX_PWM
	tristate "PWM Driver support"
        default m

config EMXX_DTV
	tristate "DTV Interface support"

config EMXX_DTV_BUFFERSIZE
	int "DMA buffer size (752-)[byte]"
	depends on EMXX_DTV
	default "8192"

config EMXX_PWC
	bool "DA9052"
	default y

config EMXX_EXTIO
	bool "EMXX_EXTIO"
	depends on (EMEV_BOARD_EVA || EMGR_BOARD_EVA) && I2C
	default y

config EMXX_AXP192_PWC
       bool "EMEV AXP 192 driver support"
       depends on I2C
       default y

config EMXX_LED
	bool LED
	default y

config EMXX_PDMA
	tristate "Software interrupt support for PDMA"
	depends on MACH_EMGR
	default y

config EMXX_INTERDSP
	tristate "InterDSP support"
	default m

if MACH_EMEV
config EMXX_DMA_LCH0
	int "P2M/M2P DMA LCH0 device"
	default 7
	help
	   0:MMM    1:MSP_GDF  2:MSP_PB  3:CRP
	   6:UART0  7:UART1    8:UART2   9:UART3 10:SIO0  11:SIO1 
	   12:SIO2 13:SIO3    14:SIO4   15:SIO5

config EMXX_DMA_LCH1
	int "P2M/M2P DMA LCH1 device"
	default 0
	help
	   0:MMM    1:MSP_GDF  2:MSP_PB  3:CRP
	   6:UART0  7:UART1    8:UART2   9:UART3 10:SIO0  11:SIO1 
	   12:SIO2 13:SIO3    14:SIO4   15:SIO5

config EMXX_DMA_LCH2
	int "P2M/M2P DMA LCH2 device"
	default 1
	help
	   0:MMM    1:MSP_GDF  2:MSP_PB  3:CRP 
	   6:UART0  7:UART1    8:UART2   9:UART3 10:SIO0  11:SIO1 
	   12:SIO2 13:SIO3    14:SIO4   15:SIO5

config EMXX_DMA_LCH3
	int "P2M/M2P DMA LCH3 device"
	default 2
	help
	   0:MMM    1:MSP_GDF  2:MSP_PB  3:CRP
	   6:UART0  7:UART1    8:UART2   9:UART3 10:SIO0  11:SIO1 
	   12:SIO2 13:SIO3    14:SIO4   15:SIO5

config EMXX_DMA_LCH4
	int "P2M/M2P DMA LCH4 device"
	default 10
	help
	   0:MMM    1:MSP_GDF  2:MSP_PB  3:CRP
	   6:UART0  7:UART1    8:UART2   9:UART3 10:SIO0  11:SIO1 
	   12:SIO2 13:SIO3    14:SIO4   15:SIO5

config EMXX_DMA_LCH5
	int "P2M/M2P DMA LCH5 device"
	default 11
	help
	   0:MMM    1:MSP_GDF  2:MSP_PB  3:CRP
	   6:UART0  7:UART1    8:UART2   9:UART3 10:SIO0  11:SIO1 
	   12:SIO2 13:SIO3    14:SIO4   15:SIO5

config EMXX_DMA_LCH6
	int "P2M/M2P DMA LCH6 device"
	default 12
	help
	   0:MMM    1:MSP_GDF  2:MSP_PB  3:CRP
	   6:UART0  7:UART1    8:UART2   9:UART3 10:SIO0  11:SIO1 
	   12:SIO2 13:SIO3    14:SIO4   15:SIO5

config EMXX_DMA_LCH7
	int "P2M/M2P DMA LCH7 device"
	default 13
	help
	   0:MMM    1:MSP_GDF  2:MSP_PB  3:CRP
	   6:UART0  7:UART1    8:UART2   9:UART3 10:SIO0  11:SIO1 
	   12:SIO2 13:SIO3    14:SIO4   15:SIO5
endif

if MACH_EMGR
config EMXX_DMA_LCH0
	int "P2M/M2P DMA LCH0 device"
	default 7
	help
	   0:MMM    1:MSP_GDF  2:MSP_PB  4:UART4  5:UART5
	   6:UART0  7:UART1    8:UART2   9:UART3 10:SIO0  11:SIO1
	   12:SIO2 13:SIO3

config EMXX_DMA_LCH1
	int "P2M/M2P DMA LCH1 device"
	default 0
	help
	   0:MMM    1:MSP_GDF  2:MSP_PB  4:UART4  5:UART5
	   6:UART0  7:UART1    8:UART2   9:UART3 10:SIO0  11:SIO1
	   12:SIO2 13:SIO3

config EMXX_DMA_LCH2
	int "P2M/M2P DMA LCH2 device"
	default 1
	help
	   0:MMM    1:MSP_GDF  2:MSP_PB  4:UART4  5:UART5
	   6:UART0  7:UART1    8:UART2   9:UART3 10:SIO0  11:SIO1
	   12:SIO2 13:SIO3

config EMXX_DMA_LCH3
	int "P2M/M2P DMA LCH3 device"
	default 2
	help
	   0:MMM    1:MSP_GDF  2:MSP_PB  4:UART4  5:UART5
	   6:UART0  7:UART1    8:UART2   9:UART3 10:SIO0  11:SIO1
	   12:SIO2 13:SIO3

config EMXX_DMA_LCH4
	int "P2M/M2P DMA LCH4 device"
	default 10
	help
	   0:MMM    1:MSP_GDF  2:MSP_PB  4:UART4  5:UART5
	   6:UART0  7:UART1    8:UART2   9:UART3 10:SIO0  11:SIO1
	   12:SIO2 13:SIO3

config EMXX_DMA_LCH5
	int "P2M/M2P DMA LCH5 device"
	default 11
	help
	   0:MMM    1:MSP_GDF  2:MSP_PB  4:UART4  5:UART5
	   6:UART0  7:UART1    8:UART2   9:UART3 10:SIO0  11:SIO1
	   12:SIO2 13:SIO3

config EMXX_DMA_LCH6
	int "P2M/M2P DMA LCH6 device"
	default 12
	help
	   0:MMM    1:MSP_GDF  2:MSP_PB  4:UART4  5:UART5
	   6:UART0  7:UART1    8:UART2   9:UART3 10:SIO0  11:SIO1
	   12:SIO2 13:SIO3

config EMXX_DMA_LCH7
	int "P2M/M2P DMA LCH7 device"
	default 13
	help
	   0:MMM    1:MSP_GDF  2:MSP_PB  4:UART4  5:UART5
	   6:UART0  7:UART1    8:UART2   9:UART3 10:SIO0  11:SIO1
	   12:SIO2 13:SIO3
endif

endmenu

endif
```

## drivers/media/video/emxx_cam/Kconfig
```kconfig
config VIDEO_EMXX_CAMERA
	tristate "EMXX front camera support"
	depends on VIDEO_DEV && MACH_EMEV
	help
	  SoC Camera is a common API to several cameras, not connecting
	  over a bus like PCI or USB. For example some i2c camera connected
	  directly to the data bus of an SoC.

choice
	prompt "Front Camera Device"
	depends on VIDEO_EMXX_CAMERA
	default CAMERA_NULL_FRONT_CAMERA

config EMXX_CAMERA_OV767X
    boolean "OV767x, 0.3 mega pixels"

config EMXX_CAMERA_GC0307
    boolean "GC0307, 0.3 mega pixels"

config CAMERA_NULL_FRONT_CAMERA
    boolean "Not support front camera"

endchoice

config VIDEO_EMXX_REAR_CAMERA
	tristate "EMXX rear camera support"
	depends on VIDEO_DEV && MACH_EMEV
choice
	prompt "Rear Camera Device"
	depends on VIDEO_EMXX_REAR_CAMERA
	default CAMERA_NULL_BACK_CAMERA

config CAMERA_EMXX_OV3640
    boolean "OV3640, 3.2 mega pixels"

config CAMERA_NULL_BACK_CAMERA
    boolean "Not support back camera"

endchoice
```

## drivers/misc/emxx_sensors/Kconfig
```kconfig
config EMXX_SENSORS
	bool "EMXX Sensors, include GSensor, MAGSensor, ..."
	depends on I2C 

config INPUT_BMA220_G_SENSORS
	bool "BMA220 3-axis sensors"
	depends on EMXX_SENSORS
```
